## config/boards/shields/tbk-mini/Kconfig.shield
```kconfig
config SHIELD_TBK-MINI_LEFT
    def_bool $(shields_list_contains,tbk-mini_left)

config SHIELD_TBK-MINI_RIGHT
    def_bool $(shields_list_contains,tbk-mini_right) 
```
