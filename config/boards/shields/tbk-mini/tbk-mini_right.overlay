// iris_right.overlay

#include "tbk-mini.dtsi"

&default_transform { // The matrix transform for this board is 6 columns over because the left half is 6 columns wide according to the matrix.
    col-offset = <5>;
};

&kscan0 {
    col-gpios
        = <&pro_micro_d 10 GPIO_ACTIVE_HIGH>
        , <&pro_micro_d 16 GPIO_ACTIVE_HIGH> 
        , <&pro_micro_d 14 GPIO_ACTIVE_HIGH> 
        , <&pro_micro_d 15 GPIO_ACTIVE_HIGH> 
        , <&pro_micro_a 0 GPIO_ACTIVE_HIGH>
        ;
};

